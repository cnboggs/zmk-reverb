## boards/shields/reverb/Kconfig.defconfig
```kconfig
# Copyright (c) 2024 Noah Boggs 
# SPDX-License-Identifier: MIT

if SHIELD_REVERB_RIGHT # TODO: make left the main 

config ZMK_KEYBOARD_NAME
    default "Reverb"

config ZMK_SPLIT_ROLE_CENTRAL
    default y

endif

if SHIELD_REVERB_LEFT || SHIELD_REVERB_RIGHT

config ZMK_SPLIT
    default y

# TODO: add nice!nano and view zmk config needed here

endif
```

## boards/shields/reverb/Kconfig.shield
```kconfig
# Copyright (c) 2024 Noah Boggs 
# SPDX-License-Identifier: MIT

config SHIELD_REVERB_LEFT
   def_bool $(shields_list_contains,reverb_left)

config SHIELD_REVERB_RIGHT
   def_bool $(shields_list_contains,reverb_right)
```

## config/west.yml
```yaml
manifest:
  remotes:
    - name: zmkfirmware
      url-base: https://github.com/petejohanson
    - name: cnboggs 
      url-base: https://github.com/cnboggs
    # Additional modules containing boards/shields/custom code can be listed here as well
    # See https://docs.zephyrproject.org/3.2.0/develop/west/manifest.html#projects
  projects:
    - name: zmk
      remote: zmkfirmware
      revision: feat/pointers-move-scroll
      import: app/west.yml
    - name: zmk-pmw3389-driver
      remote: cnboggs
      revision: pmw3389
  #   - name: pmw3389_zephyr_driver
  #     remote: cnboggs
  #     revision: debug
  #     path: modules/pmw3389
  self:
    path: config
```
